## configs/devel_build_test_defconfig
```kconfig
CONFIG_PLL_VERBOSE=y
CONFIG_PFILTER_VERBOSE=y
CONFIG_WRC_VERBOSE=y
CONFIG_VLAN=y
CONFIG_LATENCY_ETHTYPE=4455
CONFIG_P2P=y
CONFIG_IP=y
CONFIG_CMD_CONFIG=y
CONFIG_SYSLOG=y
CONFIG_BUILD_INIT=y
CONFIG_INIT_COMMAND="help"
CONFIG_DEVELOPER=y
CONFIG_CMD_LL=y
CONFIG_CHECK_RESET=y
CONFIG_SPLL_FIFO_LOG=y
CONFIG_DETERMINISTIC_BINARY=y
CONFIG_NET_VERBOSE=y
CONFIG_FAKE_TEMPERATURES=y
CONFIG_LATENCY_PROBE=y
```
